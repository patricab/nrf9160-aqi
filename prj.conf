## CMakeLists.txt
```
#
# Copyright (c) 2018 Nordic Semiconductor
#
# SPDX-License-Identifier: LicenseRef-Nordic-5-Clause
#

cmake_minimum_required(VERSION 3.13.1)

set(PM_STATIC_YML_FILE
  ${CMAKE_CURRENT_SOURCE_DIR}/configuration/${BOARD}/pm_static.yml
  )

find_package(Zephyr REQUIRED HINTS $ENV{ZEPHYR_BASE})
project(nrf9160-aqi)
zephyr_compile_definitions(PROJECT_NAME=${PROJECT_NAME})

# NORDIC SDK APP START
target_sources(app PRIVATE src/main.c)
target_sources(app PRIVATE src/settings.c)
zephyr_include_directories(src)
# NORDIC SDK APP END

# Include application events and configuration headers
zephyr_library_include_directories(
  src/lwm2m
  src/ui
  src/lib
  # src/sensor/bh1749
  # src/sensor/dgso3
  # src/sensor/sensor_sim
  # src/sensor/sps30
  )

# Application sources
add_subdirectory(src/lwm2m)
add_subdirectory(src/ui)
add_subdirectory(src/lib)
```

## Kconfig
```
# Copyright (c) 2018 Nordic Semiconductor ASA
#
# SPDX-License-Identifier: LicenseRef-Nordic-5-Clause
#

menu "Application sample"

rsource "src/ui/Kconfig"
rsource "src/lwm2m/Kconfig.ipso"

config GAS 
	bool "Use gas (DGSO3) sensor"
	default n
config PMS 
	bool "Use particle (SPS30) sensor"
	default n
	
config APP_LWM2M_SERVER
	string "LwM2M server name or IP address"
	help
	  Choose the LwM2M server you wish to connect to.

config APP_LWM2M_CLIENT
	string "LwM2M client endpoint name"
	help
	  Choose the name of your client on the server.

config LWM2M_IPSO_CONC_SENSOR
	bool "Use Ozone/NO2 sensor"
	default n
	help
	  Use gas sensor

config LWM2M_OPENLX_SP_PRTCL_SENSOR
	bool "Use PM sensor"
	default n
	help
	  Use particle sensor

config LWM2M_IPSO_COLOUR_SENSOR
	bool "Use Colour/light sensor"
	default n
	help
	  Use colour/light sensor

config APP_HOLD_TIME_RSRP
	int "Minimum time [s] between RSRP notification messages"
	default 60
	help
	  The minimum time in seconds that notifications can be sent to
	  observers of the Connectivity Monitoring data.

config APP_HOLD_TIME_GPS
	int "Minimum time [s] between location data notification messages"
	default 60
	help
	  The minimum time in seconds that notifications can be sent to
	  observers of the Location data.

config APP_MCUBOOT_FLASH_BUF_SZ
	int "Size of buffer used for flash write operations during MCUboot updates"
	depends on DFU_TARGET_MCUBOOT
	default 512
	help
	  Buffer size must be aligned to the minimal flash write block size.

choice
	prompt "GPS device"
	default GPS_USE_SIM
	help
		Select from which device GPS data will be fetched.

config GPS_USE_SIM
	bool "Use GPS simulator"
	select GPS_SIM
	select GPS_SIM_TRIGGER
	help
		Use simulated GPS data.

config GPS_USE_EXTERNAL
	bool "User provided GPS device"
	help
		Provide a GPS device that location data will be fetched from and
		sent to nRF Cloud

endchoice

if GPS_USE_SIM

config GPS_DEV_NAME
	string
	default GPS_SIM_DEV_NAME

config GPS_TRIGGER
	bool
	default GPS_SIM_TRIGGER

endif

if GPS_USE_EXTERNAL
config GPS_DEV_NAME
	string "GPS device name"
	help
		GPS device from which location data will be fetched and sent
		to nRF Cloud.

endif

choice
	prompt "Accelerometer device"
	default ACCEL_USE_SIM
	help
		Select which device will provide accelerometer data.

config ACCEL_USE_SIM
	bool "Use simulated accelerometer data"
	select SENSOR
	select SENSOR_SIM
	select SENSOR_SIM_TRIGGER
	help
		Use sensor simulator to generate accelerometer data for
		flip detection data sent to nRF Cloud.

config ACCEL_USE_EXTERNAL
	bool "User provided accelerometer device"
	help
		The user will provide an accelerometer device that will
		be used for flip detection.

endchoice

if ACCEL_USE_SIM
config ACCEL_DEV_NAME
	string
	default SENSOR_SIM_DEV_NAME

config ACCEL_TRIGGER
	bool
	default SENSOR_SIM_TRIGGER

config FLIP_INPUT
	int "Button or switch number to simulate flip"
	range 1 4 if BOARD_NRF9160DK_NRF9160NS
	default 3 if BOARD_NRF9160DK_NRF9160NS
	default 0
	help
		Button or switch number to use for simulating
		a board flip event.
		0 - not set
		1 - Button 1
		2 - Button 2
		3 - Switch 1
		4 - Switch 2
endif

config FLIP_POLL
	bool "Use polling to detect flip"
	help
		Poll the defined accelerometer device at interval determined by
		FLIP_POLL_INTERVAL. Data will be sent to nRF Cloud if a flip
		has happened and the orientation thus has changed.

if FLIP_POLL
config FLIP_POLL_INTERVAL
	int "Flip detection poll interval"
	default 1000
	help
		Flip polling interval in milliseconds.
endif

if ACCEL_USE_EXTERNAL

config ACCEL_DEV_NAME
	string "Accelerometer device name"
	help
		Device from which accelerometer data will be fetched and used
		for orientation detection and sent to nRF Cloud.

endif

config ACCEL_INVERTED
	bool "Accelerometer inverted"
	help
		Enable if the accelerometer is mounted with the top side facing
		down when the board itself is in normal position.

config ACCEL_CALIBRATE
	bool "Calibrate accelerometer"
	help
		Calibrate the accelerometer on a flat surface to filter away
		static measurement offset that could affect orientation
		detection.

if ACCEL_CALIBRATE
config ACCEL_CALIBRATION_ITERATIONS
	int "Number of readings for calibration"
	help
		Number of measurement readings to average over to find the
		static offset in the readings when calibrating the
		accelerometer.

config CALIBRATION_INPUT
	int "Button to trigger accelerometer calibration"
	range 1 2 if BOARD_NRF9160DK_NRF9160NS
	default 1 if BOARD_NRF9160DK_NRF9160NS
	help
		Button number to use to trigger accelerometer calibration:
		1 - Button 1
		2 - Button 2
endif

if !ACCEL_CALIBRATE
config ACCEL_CALIBRATION_ITERATIONS
	int
	default 0
endif

config ACCEL_ITERATIONS
	int "Number of readings per measurement"
	default 1
	help
		Number of measurement readings to average over for each time
		the orientation detector determines the orientation of the
		board. Used for simple filtering of noisy measurements.

module = APP
module-dep = LOG
module-str = Log level for sample
source "${ZEPHYR_BASE}/subsys/logging/Kconfig.template.log_config"

endmenu

menu "Zephyr Kernel"
source "Kconfig.zephyr"
endmenu
```

## sample.yaml
```
sample:
  name: nrf LwM2M client
tests:
  nrf9160-aqi:
    build_only: true
    build_on_all: true
    extra_args: OVERLAY_CONFIG=overlay-ci.conf
    platform_allow: nrf9160dk_nrf9160ns, thingy91_nrf9160ns
    tags: ci_build
```

## prj.conf
```kconfig
# General config
CONFIG_NEWLIB_LIBC=y
CONFIG_ASSERT=y
CONFIG_REBOOT=y

# Network
CONFIG_NETWORKING=y
CONFIG_NET_NATIVE=n
CONFIG_NET_IPV6=n
CONFIG_NET_IPV4=y
CONFIG_NET_SOCKETS=y
CONFIG_NET_SOCKETS_OFFLOAD=y

# LwM2M
CONFIG_LWM2M=y
CONFIG_LWM2M_DNS_SUPPORT=y
CONFIG_LWM2M_RW_JSON_SUPPORT=n
CONFIG_LWM2M_SERVER_DEFAULT_PMIN=1
CONFIG_LWM2M_SERVER_DEFAULT_PMAX=300
CONFIG_LWM2M_CONN_MON_OBJ_SUPPORT=y
CONFIG_LWM2M_CONN_MON_BEARER_MAX=2
CONFIG_LWM2M_FIRMWARE_UPDATE_OBJ_SUPPORT=y
CONFIG_LWM2M_LOCATION_OBJ_SUPPORT=n
CONFIG_LWM2M_IPSO_SUPPORT=y
CONFIG_LWM2M_IPSO_LIGHT_CONTROL=n
CONFIG_LWM2M_IPSO_BUZZER=n
CONFIG_LWM2M_IPSO_ONOFF_SWITCH=n
CONFIG_LWM2M_IPSO_ONOFF_SWITCH_INSTANCE_COUNT=2
CONFIG_LWM2M_IPSO_PUSH_BUTTON=n
CONFIG_LWM2M_IPSO_PUSH_BUTTON_INSTANCE_COUNT=2
CONFIG_LWM2M_IPSO_ACCELEROMETER=n
CONFIG_LWM2M_IPSO_TIMESTAMP_EXTENSIONS=y
CONFIG_LWM2M_IPSO_COLOUR_SENSOR=n
CONFIG_LWM2M_OPENLX_SP_SUPPORT=y
CONFIG_LWM2M_OPENLX_SP_PRTCL_SENSOR=n
CONFIG_LWM2M_IPSO_LIGHT_CONTROL=n

CONFIG_LWM2M_IPSO_GENERIC_SENSOR=y
CONFIG_LWM2M_IPSO_GENERIC_SENSOR_INSTANCE_COUNT=5
CONFIG_LWM2M_IPSO_TEMP_SENSOR=y
CONFIG_LWM2M_IPSO_HUMIDITY_SENSOR=y
CONFIG_LWM2M_IPSO_CONC_SENSOR=y
CONFIG_GAS=n
CONFIG_PMS=y
CONFIG_LWM2M_OPENLX_SP_PRTCL_SENSOR_INSTANCE_COUNT=3

# DTLS settings
# if n 5683
CONFIG_LWM2M_DTLS_SUPPORT=y
CONFIG_LWM2M_PEER_PORT=5684

# nRF9160 helper libraries
CONFIG_MODEM_KEY_MGMT=y

# Default app to debug logging
# CONFIG_LOG=y
# CONFIG_APP_LOG_LEVEL_DBG=y

# Expand logging memory to avoid log_strdup() errors
CONFIG_LOG_STRDUP_MAX_STRING=64
CONFIG_LOG_STRDUP_BUF_COUNT=32

# Support HEX style PSK values (double the size + NULL char)
CONFIG_LWM2M_SECURITY_KEY_SIZE=33

# extend CoAP retry timing to 10 seconds for LTE/LTE-M
CONFIG_COAP_INIT_ACK_TIMEOUT_MS=10000

# Enable CoAP extended option length
CONFIG_COAP_EXTENDED_OPTIONS_LEN=y
CONFIG_COAP_EXTENDED_OPTIONS_LEN_VALUE=40

# UI settings
CONFIG_UI_BUTTON=n
CONFIG_UI_BUZZER=n
CONFIG_UI_LED_USE_PWM=n

# FOTA
CONFIG_DFU_TARGET=y

# Flash
CONFIG_FLASH=y
CONFIG_FLASH_PAGE_LAYOUT=y
CONFIG_FLASH_MAP=y
CONFIG_MPU_ALLOW_FLASH_WRITE=y

# MCUBOOT
CONFIG_BOOTLOADER_MCUBOOT=y
CONFIG_IMG_MANAGER=y
CONFIG_MCUBOOT_IMG_MANAGER=y
CONFIG_IMG_ERASE_PROGRESSIVELY=y

# Enable temp sensor
CONFIG_SENSOR=y

# Enable settings storage
CONFIG_SETTINGS=y
CONFIG_FCB=y
CONFIG_SETTINGS_FCB=y

# LTE link control
CONFIG_LTE_LINK_CONTROL=y
CONFIG_LTE_AUTO_INIT_AND_CONNECT=n

# Modem library
CONFIG_NRF_MODEM_LIB=y

# Modem info
CONFIG_MODEM_INFO=y
CONFIG_MODEM_INFO_ADD_DATE_TIME=n

# Library for buttons and LEDs
CONFIG_DK_LIBRARY=y
CONFIG_DK_LIBRARY_INVERT_LEDS=n

# Enable shell
CONFIG_NET_SHELL=y

# Heap and stacks
CONFIG_HEAP_MEM_POOL_SIZE=16384
CONFIG_MAIN_STACK_SIZE=8192
CONFIG_SYSTEM_WORKQUEUE_STACK_SIZE=2048

# Temporarily disable CC310 entropy driver
CONFIG_ENTROPY_CC3XX=n
CONFIG_TEST_RANDOM_GENERATOR=y

# Set LwM2M Server IP address here
CONFIG_APP_LWM2M_SERVER="airq.freedombox.rocks"

# Set LwM2M Client Endpoint name here
CONFIG_APP_LWM2M_CLIENT="nrf9160dk-p"

# I2C
CONFIG_I2C=y

# UART settings
# CONFIG_SERIAL=y
# CONFIG_PRINTK=y
# CONFIG_UART_INTERRUPT_DRIVEN=y
# CONFIG_TRUSTED_EXECUTION_NONSECURE=y
# CONFIG_BOOT_BANNER=n
```

## overlay-bootstrap.conf
```kconfig
CONFIG_LWM2M_PEER_PORT=5784
CONFIG_LWM2M_RD_CLIENT_SUPPORT_BOOTSTRAP=y
```

## overlay-ci.conf
```kconfig
# LwM2M server needs to be set to pass CI
CONFIG_APP_LWM2M_SERVER="passci"
CONFIG_APP_LWM2M_CLIENT="passci"
```

## overlay-low-power.conf
```kconfig
#
# Copyright (c) 2021 Nordic Semiconductor ASA
#
# SPDX-License-Identifier: LicenseRef-Nordic-5-Clause
#

# This file contains configurations to achieve the lowest power consumption by
# disabling LEDs and logging over UART.

# Disable serial interface.
CONFIG_SERIAL=n

# Disable LEDs
# CONFIG_LED_CONTROL=n

# Disable UART console.
CONFIG_UART_CONSOLE=n

# Disable event logging.
CONFIG_DESKTOP_EVENT_MANAGER_SHOW_EVENTS=n
```

## overlay-nbiot.conf
```kconfig
CONFIG_LTE_NETWORK_MODE_NBIOT=n
CONFIG_COAP_INIT_ACK_TIMEOUT_MS=15000
CONFIG_LWM2M_ENGINE_DEFAULT_LIFETIME=90

# TODO Uncomment after a Zephyr upmerge
# CONFIG_LWM2M_SECONDS_TO_UPDATE_EARLY=30
```

## overlay-queue.conf
```kconfig
# Disable DTLS. Public Eclipse Leshane drops DTLS session after ~half a minute.
# CONFIG_LWM2M_DTLS_SUPPORT=n
# CONFIG_LWM2M_PEER_PORT=5683

# Enable LwM2M Queue Mode
CONFIG_LWM2M_QUEUE_MODE_ENABLED=y
CONFIG_LWM2M_ENGINE_DEFAULT_LIFETIME=300

# Configure PSM mode
# TAU to 300 seconds - LWM2M default lifetime
# https://infocenter.nordicsemi.com/index.jsp?topic=%2Fref_at_commands%2FREF%2Fat_commands%2Fnw_service%2Fcpsms.html
CONFIG_LTE_PSM_REQ_RPTAU="10100101"
# RAT to 120 seconds - not possible to set any closer to default 93 seconds
CONFIG_LTE_PSM_REQ_RAT="00100010"
# Opt: 30s == 00001111

# Disable serial interface.
CONFIG_SERIAL=n

# Disable LEDs
# CONFIG_LED_CONTROL=n
CONFIG_LED=n

# Disable UART console.
CONFIG_UART_CONSOLE=n

# Disable event logging.
CONFIG_DESKTOP_EVENT_MANAGER_SHOW_EVENTS=n

# Logging
CONFIG_LOG=n
CONFIG_APP_LOG_LEVEL_DBG=n
```

## boards/thingy91_nrf9160ns.conf
```kconfig
#
# Copyright (c) 2021 Nordic Semiconductor ASA
#
# SPDX-License-Identifier: LicenseRef-Nordic-5-Clause
#

# Configuration file for Thingy:91.
# This file is merged with prj.conf in the application folder, and options
# set here will take precedence if they are present in both files.

# Configuration related to external sensors.
CONFIG_SENSOR=y
CONFIG_SPI=n
CONFIG_I2C=y

# ADXL362 - Accelerometer
CONFIG_ADXL362=n
CONFIG_ADXL362_TRIGGER_GLOBAL_THREAD=n
CONFIG_ADXL362_INTERRUPT_MODE=1
CONFIG_ADXL362_ABS_REF_MODE=1
CONFIG_ADXL362_ACCEL_RANGE_2G=n
CONFIG_ADXL362_ACCEL_ODR_12_5=n

# BME680 - Temperature and humidity sensor.
CONFIG_BME680=y
```

## nrf9160dk_nrf9160ns.overlay
```dts
/*
 * Copyright (c) 2021 Nordic Semiconductor ASA
 *
 * SPDX-License-Identifier: LicenseRef-Nordic-5-Clause
 */

&uart1 {
	status = "okay";
	current-speed = <9600>;
	tx-pin = <0>;
	rx-pin = <1>;
};

&i2c3 {
	status = "okay";
	compatible = "nordic,nrf-twim";
	sda-pin = <30>;
	scl-pin = <31>;
	clock-frequency = <I2C_BITRATE_STANDARD>;
};

&spi3 {
    status = "disabled";
};
```

## thingy91_nrf9160ns.overlay
```dts
/*
 * Copyright (c) 2021 Nordic Semiconductor ASA
 *
 * SPDX-License-Identifier: LicenseRef-Nordic-5-Clause
 */

&uart1 {
	compatible = "nordic,nrf-uarte";
	current-speed = <9600>;
	status = "okay";
	tx-pin = <4>;
	rx-pin = <5>;
};

/*
&i2c2 {
	compatible = "nordic,nrf-twim";
	status = "okay";
	sda-gpios = <&gpio0 11 0>;
	scl-gpios = <&gpio0 12 0>;
	clock-frequency = <I2C_BITRATE_FAST>;

	bme680@76 {
		compatible = "bosch,bme680";
		label = "BME680";
		reg = <0x76>;
	};

	bh1749@38 {
			compatible = "rohm,bh1749";
			label = "BH1749";
			reg = <0x38>;
			int-gpios = <&gpio0 27 0>;
	};
};
*/
```

## src/main.c
```c
/*
 * Copyright (c) 2019 Nordic Semiconductor ASA
 *
 * SPDX-License-Identifier: LicenseRef-Nordic-5-Clause
 */

#include <zephyr.h>
#include <ctype.h>
#include <drivers/gpio.h>
#include <stdio.h>
#include <net/lwm2m.h>
#include <modem/nrf_modem_lib.h>
#include <settings/settings.h>

#include <logging/log.h>
LOG_MODULE_REGISTER(app_lwm2m_client, CONFIG_APP_LOG_LEVEL);

#include <modem/at_cmd.h>
#include <modem/lte_lc.h>

#if defined(CONFIG_LWM2M_DTLS_SUPPORT)
#if defined(CONFIG_MODEM_KEY_MGMT)
#include <modem/modem_key_mgmt.h>
#endif
#endif

#include "ui.h"
#include "lwm2m_client.h"
#include "settings.h"

#if !defined(CONFIG_LTE_LINK_CONTROL)
#error "Missing CONFIG_LTE_LINK_CONTROL"
#endif

BUILD_ASSERT(sizeof(CONFIG_APP_LWM2M_SERVER) > 1,
		 "CONFIG_APP_LWM2M_SERVER must be set in prj.conf");
/*BUILD_ASSERT(sizeof(CONFIG_APP_LWM2M_CLIENT) > 1,
		 "CONFIG_APP_LWM2M_CLIENT must be set in prj.conf");*/

#define APP_BANNER "Run LWM2M client"

#define IMEI_LEN		15

#define ENDPOINT_NAME_LEN sizeof(CONFIG_APP_LWM2M_CLIENT)

#define LWM2M_SECURITY_PRE_SHARED_KEY 0
#define LWM2M_SECURITY_RAW_PUBLIC_KEY 1
#define LWM2M_SECURITY_CERTIFICATE 2
#define LWM2M_SECURITY_NO_SEC 3

static uint8_t endpoint_name[ENDPOINT_NAME_LEN+1];
static uint8_t imei_buf[IMEI_LEN + 5]; /* account for /n/r */
static struct lwm2m_ctx client;

#if defined(CONFIG_LWM2M_DTLS_SUPPORT)
#include "config.h"
#endif /* CONFIG_LWM2M_DTLS_SUPPORT */

static struct k_sem lwm2m_restart;

static void rd_client_event(struct lwm2m_ctx *client,
			    enum lwm2m_rd_client_event client_event);

void client_acknowledge(void)
{
	lwm2m_acknowledge(&client);
}

/**@brief User interface event handler. */
static void ui_evt_handler(struct ui_evt *evt)
{
	if (!evt) {
		return;
	}

	LOG_DBG("Event: %d", evt->button);

#if defined(CONFIG_UI_BUTTON)
	if (handle_button_events(evt) == 0) {
		return;
	}
#endif
#if defined(CONFIG_LWM2M_IPSO_ACCELEROMETER) && CONFIG_FLIP_INPUT > 0
	if (handle_accel_events(evt) == 0) {
		return;
	}
#endif
}

static int remove_whitespace(char *buf)
{
	size_t i, j = 0, len;

	len = strlen(buf);
	for (i = 0; i < len; i++) {
		if (buf[i] >= 32 && buf[i] <= 126) {
			if (j != i) {
				buf[j] = buf[i];
			}

			j++;
		}
	}

	if (j < len) {
		buf[j] = '\0';
	}

	return 0;
}

static int query_modem(const char *cmd, char *buf, size_t buf_len)
{
	int ret;
	enum at_cmd_state at_state;

	ret = at_cmd_write(cmd, buf, buf_len, &at_state);
	if (ret) {
		LOG_ERR("at_cmd_write [%s] error:%d, at_state: %d",
			cmd, ret, at_state);
		strncpy(buf, "error", buf_len);
		return ret;
	}

	remove_whitespace(buf);
	return 0;
}

static int lwm2m_setup(void)
{
	/* use IMEI as serial number */
	lwm2m_init_device(imei_buf);
	lwm2m_init_security(&client, endpoint_name);

// Gas (DGSO3)
#if defined(CONFIG_GAS)
	lwm2m_init_gas();
#endif
// Particle (SPS30)
#if defined(CONFIG_PMS)
	lwm2m_init_pms();
#endif
#if defined(CONFIG_LWM2M_IPSO_CONC_SENSOR)
	/* Gas (Resistance) */
	lwm2m_init_gas_res();
#endif

#if defined(CONFIG_LWM2M_LOCATION_OBJ_SUPPORT)
	lwm2m_init_location();
#endif
#if defined(CONFIG_LWM2M_FIRMWARE_UPDATE_OBJ_SUPPORT)
	lwm2m_init_firmware();
#endif
#if defined(CONFIG_LWM2M_CONN_MON_OBJ_SUPPORT)
	lwm2m_init_connmon();
#endif
#if defined(CONFIG_LWM2M_IPSO_LIGHT_CONTROL)
	lwm2m_init_light_control();
#endif
#if defined(CONFIG_LWM2M_IPSO_TEMP_SENSOR)
	lwm2m_init_temp();
#endif
#if defined(CONFIG_LWM2M_IPSO_HUMIDITY_SENSOR)
	lwm2m_init_hum();
#endif
#if defined(CONFIG_LWM2M_OPENLX_SP_PRTCL_SENSOR)
	lwm2m_init_prtcl();
#endif
#if defined(CONFIG_UI_BUZZER)
	lwm2m_init_buzzer();
#endif
#if defined(CONFIG_UI_BUTTON)
	lwm2m_init_button();
#endif
#if defined(CONFIG_LWM2M_IPSO_ACCELEROMETER)
	lwm2m_init_accel();
#endif
	return 0;
}

int lwm2m_security_index_to_inst_id(int index);

static int find_server_security_instance(void)
{
	char pathstr[10];
	bool bootstrap;
	int i;
	int instance;
	int ret;

	for (i = 0; i < CONFIG_LWM2M_SECURITY_INSTANCE_COUNT; i++) {
		instance = lwm2m_security_index_to_inst_id(i);
		if (instance < 0) {
			LOG_DBG("Empty instance at index %d", i);
			continue;
		}

		snprintk(pathstr, sizeof(pathstr), "0/%d/1", instance);

		ret = lwm2m_engine_get_bool(pathstr, &bootstrap);
		if (ret < 0) {
			LOG_ERR("Failed to check bootstrap, err %d", ret);
			continue;
		}

		if (!bootstrap) {
			LOG_DBG("Security instance found, %d", instance);
			return instance;
		}
	}

	return -1;
}

static int get_security_mode(int instance)
{
	char pathstr[10];
	uint8_t security_mode;
	int ret;

	snprintk(pathstr, sizeof(pathstr), "0/%d/2", instance);

	ret = lwm2m_engine_get_u8(pathstr, &security_mode);
	if (ret < 0) {
		LOG_ERR("Failed to obtain security mode, err %d", ret);
		return -1;
	}

	return security_mode;
}

#if defined(CONFIG_LWM2M_DTLS_SUPPORT)
static void provision_psk(int instance)
{
	char pathstr[10];
	char psk_hex[64];
	int ret;
	uint8_t *identity;
	uint16_t identity_len;
	uint8_t *psk;
	uint16_t psk_len;
	uint8_t flags;


	/* Obtain identity. */
	snprintk(pathstr, sizeof(pathstr), "0/%d/3", instance);

	ret = lwm2m_engine_get_res_data(pathstr, (void **)&identity,
					&identity_len, &flags);
	if (ret < 0) {
		LOG_ERR("Failed to obtain client identity.");
		return;
	}

	/* Obtain PSK. */
	snprintk(pathstr, sizeof(pathstr), "0/%d/5", instance);

	ret = lwm2m_engine_get_res_data(pathstr, (void **)&psk,
					&psk_len, &flags);
	if (ret < 0) {
		LOG_ERR("Failed to obtain PSK.");
		return;
	}

	/* Convert PSK to a format accepted by the modem. */
	psk_len = bin2hex(psk, psk_len, psk_hex, sizeof(psk_hex));
	if (psk_len == 0) {
		LOG_ERR("PSK is too large to convert.");
		return;
	}

	lwm2m_rd_client_stop(&client, rd_client_event);
	lte_lc_offline();

	ret = modem_key_mgmt_write(client.tls_tag,
				   MODEM_KEY_MGMT_CRED_TYPE_PSK,
				   psk_hex, psk_len);
	if (ret < 0) {
		LOG_ERR("Error setting cred tag %d type %d: Error %d",
			client.tls_tag, MODEM_KEY_MGMT_CRED_TYPE_PSK,
			ret);
		goto exit;
	}

	ret = modem_key_mgmt_write(client.tls_tag,
				   MODEM_KEY_MGMT_CRED_TYPE_IDENTITY,
				   identity, identity_len);
	if (ret < 0) {
		LOG_ERR("Error setting cred tag %d type %d: Error %d",
			client.tls_tag, MODEM_KEY_MGMT_CRED_TYPE_IDENTITY,
			ret);
	}

exit:
	lte_lc_connect();
	lwm2m_rd_client_start(&client, endpoint_name, false, rd_client_event);
}
#endif

static void provision_credentials(void)
{
	int security_instance;
	int security_mode;

	security_instance = find_server_security_instance();
	if (security_instance == -1) {
		LOG_ERR("No security instance found");
		return;
	}

	security_mode = get_security_mode(security_instance);
	if (security_mode == -1) {
		return;
	}

	switch (security_mode) {
#if defined(CONFIG_LWM2M_DTLS_SUPPORT)
	case LWM2M_SECURITY_PRE_SHARED_KEY:
		LOG_DBG("PSK mode, provisioning key and identity.");
		client.tls_tag = SERVER_TLS_TAG;
		provision_psk(security_instance);
		break;
#endif

	case LWM2M_SECURITY_NO_SEC:
		LOG_DBG("NoSec mode, no provisioning needed.");
		break;

	default:
		LOG_ERR("Unsupported security mode");
		break;
	}
}

static void rd_client_event(struct lwm2m_ctx *client,
			    enum lwm2m_rd_client_event client_event)
{
	switch (client_event) {

	case LWM2M_RD_CLIENT_EVENT_NONE:
		/* do nothing */
		break;

	case LWM2M_RD_CLIENT_EVENT_BOOTSTRAP_REG_FAILURE:
		LOG_DBG("Bootstrap registration failure!");
		break;

	case LWM2M_RD_CLIENT_EVENT_BOOTSTRAP_REG_COMPLETE:
		LOG_DBG("Bootstrap registration complete");
		break;

	case LWM2M_RD_CLIENT_EVENT_BOOTSTRAP_TRANSFER_COMPLETE:
		LOG_DBG("Bootstrap transfer complete");
		LOG_DBG("Boostrap finished, provisioning credentials.");
		provision_credentials();
		break;

	case LWM2M_RD_CLIENT_EVENT_REGISTRATION_FAILURE:
		LOG_DBG("Registration failure!");
		break;

	case LWM2M_RD_CLIENT_EVENT_REGISTRATION_COMPLETE:
		LOG_DBG("Registration complete");
		break;

	case LWM2M_RD_CLIENT_EVENT_REG_UPDATE_FAILURE:
		LOG_DBG("Registration update failure!");
		break;

	case LWM2M_RD_CLIENT_EVENT_REG_UPDATE_COMPLETE:
		LOG_DBG("Registration update complete");
		break;

	case LWM2M_RD_CLIENT_EVENT_DEREGISTER_FAILURE:
		LOG_DBG("Deregister failure!");
		break;

	case LWM2M_RD_CLIENT_EVENT_DISCONNECT:
		LOG_DBG("Disconnected");
		break;

	case LWM2M_RD_CLIENT_EVENT_QUEUE_MODE_RX_OFF:
		LOG_DBG("Queue mode RX window closed");
		break;

	case LWM2M_RD_CLIENT_EVENT_NETWORK_ERROR:
		LOG_ERR("LwM2M engine reported a network error.");
		k_sem_give(&lwm2m_restart);
		break;
	}
}

static void modem_connect(void)
{
	int ret;

#if defined(CONFIG_LWM2M_QUEUE_MODE_ENABLED)
	ret = lte_lc_psm_req(true);
	if (ret < 0) {
		LOG_ERR("lte_lc_psm_req, error: (%d)", ret);
	} else {
		LOG_INF("PSM mode requested");
	}
#endif

	do {
		LOG_INF("Connecting to LTE network.");
		LOG_INF("This may take several minutes.");
		// ui_led_set_pattern(UI_LTE_CONNECTING);

		ret = lte_lc_connect();
		if (ret < 0) {
			LOG_WRN("Failed to establish LTE connection (%d).",
				ret);
			LOG_WRN("Will retry in a minute.");
			lte_lc_offline();
			k_sleep(K_SECONDS(60));
		} else {
			LOG_INF("Connected to LTE network");
			// ui_led_set_pattern(UI_LTE_CONNECTED);
		}
	} while (ret < 0);
}

void main(void)
{
	uint32_t flags = IS_ENABLED(CONFIG_LWM2M_RD_CLIENT_SUPPORT_BOOTSTRAP) ?
				    LWM2M_RD_CLIENT_FLAG_BOOTSTRAP : 0;
	int ret;

	LOG_INF(APP_BANNER);

	k_sem_init(&lwm2m_restart, 0, 1);

	ui_init(ui_evt_handler);

	ret = fota_settings_init();
	if (ret < 0) {
		LOG_ERR("Unable to init settings (%d)", ret);
		return;
	}

	/* Load *all* persistent settings */
	settings_load();

#if defined(CONFIG_LWM2M_FIRMWARE_UPDATE_OBJ_SUPPORT)
	/* Modem FW update needs to be verified before modem is used. */
	lwm2m_verify_modem_fw_update();
#endif

	LOG_INF("Initializing modem.");
	ret = lte_lc_init();
	if (ret < 0) {
		LOG_ERR("Unable to init modem (%d)", ret);
		return;
	}

	/* query IMEI */
	query_modem("AT+CGSN", imei_buf, sizeof(imei_buf));
	// Custom endpoint name in prj.conf
	snprintf(endpoint_name, sizeof(endpoint_name), "%s", CONFIG_APP_LWM2M_CLIENT);
	/* use IMEI as unique endpoint name
	snprintf(endpoint_name, sizeof(endpoint_name), "nrf-%s", imei_buf); */
	LOG_INF("endpoint: %s", log_strdup(endpoint_name));

	/* Setup LwM2M */
	(void)memset(&client, 0x0, sizeof(client));

	ret = lwm2m_setup();
	if (ret < 0) {
		LOG_ERR("Cannot setup LWM2M fields (%d)", ret);
		return;
	}

	ret = lwm2m_init_image();
	if (ret < 0) {
		LOG_ERR("Failed to setup image properties (%d)", ret);
		return;
	}

#if defined(CONFIG_LWM2M_DTLS_SUPPORT)
	ret = modem_key_mgmt_write(client.tls_tag,
				   MODEM_KEY_MGMT_CRED_TYPE_PSK,
				   client_psk, strlen(client_psk));
	if (ret < 0) {
		LOG_ERR("Error setting cred tag %d type %d: Error %d",
			client.tls_tag, MODEM_KEY_MGMT_CRED_TYPE_PSK,
			ret);
	}

	ret = modem_key_mgmt_write(client.tls_tag,
				   MODEM_KEY_MGMT_CRED_TYPE_IDENTITY,
				   endpoint_name, strlen(endpoint_name));
	if (ret < 0) {
		LOG_ERR("Error setting cred tag %d type %d: Error %d",
			client.tls_tag, MODEM_KEY_MGMT_CRED_TYPE_IDENTITY,
			ret);
	}
#endif

	modem_connect();

#if defined(CONFIG_LWM2M_CONN_MON_OBJ_SUPPORT)
	ret = lwm2m_start_connmon();
	if (ret < 0) {
		LOG_ERR("Error registering rsrp handler (%d)", ret);
	}
#endif

	while (true) {
		lwm2m_rd_client_start(&client, endpoint_name, flags,
				      rd_client_event);

		k_sem_take(&lwm2m_restart, K_FOREVER);

		LOG_INF("LwM2M restart requested. The sample will try to"
			" re-establish network connection.");

		/* Stop the LwM2M engine. */
		lwm2m_rd_client_stop(&client, rd_client_event);

		/* Try to reconnect to the network. */
		ret = lte_lc_offline();
		if (ret < 0) {
			LOG_ERR("Failed to put LTE link in offline state. (%d)",
				ret);
		}

		modem_connect();
	}
}
```

## src/config.h
```c
/*
 * Copyright (c) 2020 Nordic Semiconductor ASA
 *
 * SPDX-License-Identifier: LicenseRef-Nordic-5-Clause
 */

#if defined(CONFIG_LWM2M_DTLS_SUPPORT)
static char client_psk[] = "234aec5efc67aecf576c5aef765fc76e"; //pre shared key
#define SERVER_TLS_TAG 35724861
#define BOOTSTRAP_TLS_TAG 35724862
#endif /* defined(CONFIG_LWM2M_DTLS_SUPPORT) */
```

## src/settings.c
```c
/*
 * Copyright (c) 2019 Nordic Semiconductor ASA
 *
 * SPDX-License-Identifier: LicenseRef-Nordic-5-Clause
 */


#include <zephyr.h>
#include <settings/settings.h>

#include "settings.h"

#include <logging/log.h>
LOG_MODULE_REGISTER(app_fota_settings, CONFIG_APP_LOG_LEVEL);

static struct update_counter uc;

int fota_update_counter_read(struct update_counter *update_counter)
{
	memcpy(update_counter, &uc, sizeof(uc));
	return 0;
}

int fota_update_counter_update(enum counter_type type, uint32_t new_value)
{
	if (type == COUNTER_UPDATE) {
		uc.update = new_value;
	} else {
		uc.current = new_value;
	}

	return settings_save_one("fota/counter", &uc, sizeof(uc));
}

static int set(const char *key, size_t len_rd, settings_read_cb read_cb,
	       void *cb_arg)
{
	int len;
	int key_len;
	const char *next;

	if (!key) {
		return -ENOENT;
	}

	key_len = settings_name_next(key, &next);

	if (!strncmp(key, "counter", key_len)) {
		len = read_cb(cb_arg, &uc, sizeof(uc));
		if (len < sizeof(uc)) {
			LOG_ERR("Unable to read update counter.  Resetting.");
			memset(&uc, 0, sizeof(uc));
		}

		return 0;
	}

	return -ENOENT;
}

static struct settings_handler fota_settings = {
	.name = "fota",
	.h_set = set,
};

int fota_settings_init(void)
{
	int err;

	err = settings_subsys_init();
	if (err) {
		LOG_ERR("settings_subsys_init failed (err %d)", err);
		return err;
	}

	err = settings_register(&fota_settings);
	if (err) {
		LOG_ERR("settings_register failed (err %d)", err);
		return err;
	}

	return 0;
}
```

## src/settings.h
```c
/*
 * Copyright (c) 2019 Nordic Semiconductor ASA
 *
 * SPDX-License-Identifier: LicenseRef-Nordic-5-Clause
 */

#ifndef FOTA_STORAGE_H__
#define FOTA_STORAGE_H__

struct update_counter {
	int current;
	int update;
};


enum counter_type {
	COUNTER_CURRENT = 0,
	COUNTER_UPDATE
};

int fota_update_counter_read(struct update_counter *update_counter);
int fota_update_counter_update(enum counter_type type, uint32_t new_value);
int fota_settings_init(void);

#endif	/* FOTA_STORAGE_H__ */
```
