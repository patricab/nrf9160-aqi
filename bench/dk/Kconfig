## bench/dk/Kconfig
```kconfig
menu "Application sample"
module = APP
module-dep = LOG
module-str = Log level for sample
source "${ZEPHYR_BASE}/subsys/logging/Kconfig.template.log_config"
endmenu

menu "Zephyr Kernel"
source "Kconfig.zephyr"
endmenu
```

## sensor/sps30/Kconfig
```kconfig
# SPS30 particulate matter sensor configuration options

config SPS30
	bool "SPS30 particulate matter sensor"
	depends on SERIAL 
	depends on I2C
	help
	  Enable driver for SPS30 UART/I2C-based particulate matter sensor.
```

## src/sensor/dgso3/Kconfig.kconfig
```kconfig
# DGS-O3 gas sensor configuration options

menuconfig DGSO3
	bool "DGS-O3 gas sensor"
	depends on SERIAL
	help
	  Enable driver for DGS-O3 UART-based gas sensor.
```

## test/Kconfig
```kconfig
menu "Application sample"

rsource "ui/Kconfig" 

module = APP
module-dep = LOG
module-str = Log level for sample
source "${ZEPHYR_BASE}/subsys/logging/Kconfig.template.log_config"
endmenu

menu "Zephyr Kernel"
source "Kconfig.zephyr"
endmenu
```
