&i2c3 {
	status = "okay";
	compatible = "nordic,nrf-twim";
	sda-pin = <30>;
	scl-pin = <31>;
    clock-frequency = <I2C_BITRATE_STANDARD>;
/*
	sps30@69 {
		compatible = "sensirion,sps30";
		label = "SPS30";
		reg = <0x69>;
	};
*/
};


&spi3 {
    status = "disabled";
};